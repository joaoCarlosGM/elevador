## main/Kconfig.projbuild
```kconfig
menu "Elevador — Maquete com HOME superior"

config ELEVATOR_MOTOR_IN1_GPIO
    int "L293D IN1 (padrao GPIO3)"
    range 0 21
    default 3
config ELEVATOR_MOTOR_IN2_GPIO
    int "L293D IN2 (padrao GPIO4)"
    range 0 21
    default 4
config ELEVATOR_HOME_GPIO
    int "Fim superior HOME NC para GND (padrao GPIO10)"
    range 0 21
    default 10

config ELEVATOR_HOME_TIMEOUT_MS
    int "Tempo maximo de busca HOME (ms)"
    range 3000 60000
    default 20000
config ELEVATOR_CAL_TIMEOUT_MS
    int "Tempo maximo de descida na calibracao (ms)"
    range 3000 60000
    default 20000

config ELEVATOR_HARDWARE_VERIFIED
    bool "Confirmo teste eletrico, parada independente e protecao mecanica"
    default n
    help
      Nunca marcar sem verificar o comando fisico IN1=IN2=LOW em falha,
      o sensor HOME NC e a capacidade de interromper energia do motor
      independentemente do ESP32. Esta opcao nao fornece protecao fisica.

menu "Wi-Fi local"
config ELEVATOR_AP_SSID
    string "Nome do ponto de acesso"
    default "Elevador"
config ELEVATOR_AP_PASSWORD
    string "Senha WPA2 (minimo 8 caracteres; troque antes de habilitar motor)"
    default "12345678"
config ELEVATOR_AP_MAX_CLIENTS
    int "Maximo de dispositivos conectados"
    range 1 4
    default 2
endmenu
endmenu
```
